/dts-v1/;
/plugin/;

/{
	compatible = "brcm,bcm2712";

	fragment@0 {
		// Enable I2S0 and attach the standard I2S pin group
		target = <&i2s_clk_producer>;   // existing I2S0 node in Pi 5 DT
		__overlay__ {

			compatible = "tutorial,pcm5102a";
			status = "okay";
			pinctrl-names = "default";
			pinctrl-0 = <&rp1_i2s0_18_21>;
		};
	};
};
